## arch/arm/configs/ext_config/furnace_defconfig
```kconfig
CONFIG_LOCALVERSION="-furnace"
CONFIG_FS_SYNC=y
CONFIG_FB_MSM_MDSS_KCAL_CTRL=y
CONFIG_SOUND_CONTROL_HAX_3_GPL=y
CONFIG_EXFAT_FS=y
CONFIG_EXFAT_DEFAULT_CODEPAGE=437
CONFIG_EXFAT_DEFAULT_IOCHARSET="utf8"
CONFIG_CPU_VOLTAGE_TABLE=y
CONFIG_KEXEC=y
CONFIG_KEXEC_HARDBOOT=y
CONFIG_ATAGS_PROC=n
CONFIG_PROC_DEVICETREE=y
CONFIG_KERNEL_LZMA=y
```
